/*
 * =============================================================================
 * 檔案名稱: invalidRFID_inrfidlist_BMduino.ino
 * 程式語言: Arduino C/C++
 * 檔案類型: 主程式檔（Sketch File）
 * 功能說明: 門禁裝置讀取卡號傳送雲端失效程式（卡片權限終止）
 * 
 * =============================================================================
 * 程式運作流程完整解說（繁體中文）
 * =============================================================================
 * 
 * 【檔案概述】
 *   本程式為雲端門禁系統的 BMduino 裝置端程式，負責讀取 RFID 卡片，
 *   並透過 HTTP GET 請求將卡片號碼傳送至雲端伺服器進行卡片權限終止（失效）作業。
 *   當感應到已授權的卡片時，系統會將該卡片的啟用狀態從「已啟用」改為「已失效」，
 *   使其無法再開啟門鎖。
 * 
 * 【主要功能】
 *   1. 初始化系統（序列埠、LED、Wi-Fi、RFID 模組）
 *   2. 持續偵測是否有 RFID 卡片靠近
 *   3. 讀取到卡片後，取得卡片的 UID（唯一識別碼）
 *   4. 檢查 Wi-Fi 連線狀態，若未連線則重新連線
 *   5. 透過 HTTP GET 將 MAC 位址與卡片號碼傳送至雲端 API（invalidrfid.php）
 *   6. 接收雲端回傳結果（JSON 格式）
 *   7. 等待 2 秒後繼續下一次讀卡循環
 * 
 * 【完整運作流程圖解】
 * 
 *   ┌─────────────────────────────────────────────────────────────────────┐
 *   │                     系統啟動（電源開啟）                              │
 *   └─────────────────────────────────────────────────────────────────────┘
 *                                      │
 *                                      ▼
 *   ┌─────────────────────────────────────────────────────────────────────┐
 *   │                    setup() 函式（執行一次）                          │
 *   │                                                                     │
 *   │   ┌─────────────────────────────────────────────────────────────┐   │
 *   │   │ 步驟 1：呼叫 initAll() 初始化整體系統                        │   │
 *   │   │   - Serial.begin(9600) 啟動序列埠通訊                        │   │
 *   │   │   - digitalWrite(LED, LOW) 熄滅內建 LED                     │   │
 *   │   │   - 呼叫 initSensor() 初始化感測器                          │   │
 *   │   │        ├── 呼叫 INITWIFI() 初始化 Wi-Fi 連線                │   │
 *   │   │        │     ├── GetWiFiInformation() 取得 WiFi 資訊       │   │
 *   │   │        │     ├── initWiFi() 連線至無線網路                  │   │
 *   │   │        │     └── ShowWiFiInformation() 顯示連線資訊        │   │
 *   │   │        └── 呼叫 initRFID() 初始化 RFID 讀卡模組             │   │
 *   │   └─────────────────────────────────────────────────────────────┘   │
 *   │                                                                     │
 *   │   輸出 "Enter Loop() Area and Start to Work" 至序列監控視窗        │
 *   └─────────────────────────────────────────────────────────────────────┘
 *                                      │
 *                                      ▼
 *   ┌─────────────────────────────────────────────────────────────────────┐
 *   │                    loop() 函式（重複執行）                           │
 *   └─────────────────────────────────────────────────────────────────────┘
 *                                      │
 *                                      ▼
 *   ┌─────────────────────────────────────────────────────────────────────┐
 *   │ 步驟 1：檢查是否有 RFID 卡片靠近                                     │
 *   │   if (checkReadRFIDSuccess())                                      │
 *   │                                                                     │
 *   │   ┌── 無卡片 ──────────────────────────────────────────────┐       │
 *   │   │                                                         │       │
 *   │   ▼                                                         ▼       │
 *   │   跳過後續處理，進入延遲                   有卡片，繼續執行          │
 *   └─────────────────────────────────────────────────────────────────────┘
 *                                      │
 *                                      ▼
 *   ┌─────────────────────────────────────────────────────────────────────┐
 *   │ 步驟 2：讀取 RFID 卡片 UID                                          │
 *   │   uidStr = readRFIDUIDString()                                     │
 *   │   輸出卡號至序列監控視窗（除錯用）                                   │
 *   └─────────────────────────────────────────────────────────────────────┘
 *                                      │
 *                                      ▼
 *   ┌─────────────────────────────────────────────────────────────────────┐
 *   │ 步驟 3：檢查 Wi-Fi 連線狀態                                         │
 *   │   if (Wifi.getStatus())                                            │
 *   │                                                                     │
 *   │   ┌── Wi-Fi 已連線 ──────────────────────────────────────┐         │
 *   │   │                                                       │         │
 *   │   ▼                                                       ▼         │
 *   │   輸出 "WIFI OK"                             Wi-Fi 未連線           │
 *   │   呼叫 SendtoClouding()                         │                   │
 *   │   傳送資料至雲端                                ▼                   │
 *   │                                     呼叫 INITWIFI() 重新連線        │
 *   │                                              │                       │
 *   │                                              ▼                       │
 *   │                                     重新檢查 Wi-Fi 狀態              │
 *   │                                              │                       │
 *   │                                     ┌── 連線成功 ──┐                │
 *   │                                     │              │                │
 *   │                                     ▼              ▼                │
 *   │                               輸出 "WIFI OK"   放棄本次傳送          │
 *   │                               呼叫 SendtoClouding()                 │
 *   └─────────────────────────────────────────────────────────────────────┘
 *                                      │
 *                                      ▼
 *   ┌─────────────────────────────────────────────────────────────────────┐
 *   │ 步驟 4：SendtoClouding() 函式（定義於 clouding.h）                   │
 *   │                                                                     │
 *   │   此函式會執行以下操作：                                             │
 *   │   1. 組合 HTTP GET 請求字串：                                       │
 *   │        /bmduino/rfid/invalidrfid.php?MAC=xxx&KEY=xxx               │
 *   │   2. 將請求傳送至雲端伺服器（iot.arduino.org.tw:8888）              │
 *   │   3. 接收伺服器回傳的 JSON 資料                                     │
 *   │   4. 解析 JSON 資料，提取驗證結果（Device、Card、Result）           │
 *   │   5. 根據回傳結果輸出對應訊息至序列監控視窗：                        │
 *   │        - "Device Not Existed"：設備未註冊                          │
 *   │        - "Card Invalided"：卡片已成功失效                          │
 *   │        - "Card Not Existed"：卡片不存在於資料庫                    │
 *   └─────────────────────────────────────────────────────────────────────┘
 *                                      │
 *                                      ▼
 *   ┌─────────────────────────────────────────────────────────────────────┐
 *   │ 步驟 5：延遲 2 秒（2000 毫秒）                                      │
 *   │   delay(2000);                                                      │
 *   │                                                                     │
 *   │   延遲的目的：                                                       │
 *   │   1. 避免因程式循環過快導致重複讀取同一張卡片                        │
 *   │   2. 避免短時間內發送過多 HTTP 請求造成雲端伺服器過度負載            │
 *   │   3. 給予使用者足夠的時間移開卡片，防止重複觸發                      │
 *   └─────────────────────────────────────────────────────────────────────┘
 *                                      │
 *                                      ▼
 *   ┌─────────────────────────────────────────────────────────────────────┐
 *   │                     返回 loop() 開頭，重複執行                        │
 *   └─────────────────────────────────────────────────────────────────────┘
 * 
 * 【與啟用/停用程式的差異說明】
 *   本程式與其他版本的差異在於呼叫的 API 不同：
 *   - 啟用程式（activateRFID_inrfidlist_BMduino.ino）：
 *       呼叫 enablerfid.php，將卡片的 activate 狀態設為 1（啟用）
 *   - 停用程式（disableRFID_inrfidlist_BMduino.ino）：
 *       呼叫 disablerfid.php，將卡片的 activate 狀態設為 0（停用）
 *   - 本程式（無效/失效程式）：
 *       呼叫 invalidrfid.php，將卡片的 activate 狀態設為 2（失效）
 * 
 * 【通訊協定說明】
 *   本系統使用 HTTP GET 方法將資料傳送至雲端伺服器：
 *     - 伺服器位址：http://iot.arduino.org.tw:8888
 *     - API 路徑：/bmduino/rfid/invalidrfid.php
 *     - 傳送參數：MAC（設備 MAC 位址）、KEY（RFID 卡號）
 * 
 * 【API 請求範例】
 *   http://iot.arduino.org.tw:8888/bmduino/rfid/invalidrfid.php?MAC=483FDACA32A3&KEY=1111222233
 * 
 * 【雲端 API 回傳結果說明 (JSON 格式)】
 * 
 *   1. 裝置不存在或未啟用：
 *      {"Device": "483FDACA32A3", "Card": "1122334455", "Result": "Device Not Existed"}
 *      說明：此設備尚未在雲端系統中註冊或已被停用
 * 
 *   2. 卡片已失效（從已啟用狀態變更為失效）：
 *      {"Device": "483FDACA32A3", "Card": "1122334455", "Result": "Card Invalided"}
 *      說明：該卡片已成功失效，將無法再開啟門鎖
 * 
 *   3. 卡片不存在（資料庫中無此卡片記錄）：
 *      {"Device": "483FDACA32A3", "Card": "1122334455", "Result": "Card Not Existed"}
 *      說明：該卡片尚未在雲端資料庫中註冊，無法失效
 * 
 * 【卡片狀態說明】
 *   - activate = 0：卡片未啟用（尚未授權）
 *   - activate = 1：卡片已啟用（正常使用中）
 *   - activate = 2：卡片已失效（曾經啟用但已被失效）
 * 
 * 【硬體需求】
 *   - BMduino 開發板（相容於 Arduino）
 *   - BMC11T001 RFID 讀寫模組（I2C 介面）
 *   - Wi-Fi 模組（內建或外接）
 *   - 繼電器模組（用於控制門鎖，本程式未實作可擴充）
 *   - OLED 顯示螢幕（可選，用於顯示訊息）
 * 
 * 【相依檔案說明】
 *   - TCP.h：提供 Wi-Fi 連線相關函式（GetSSID、GetIP、GetMAC、initWiFi 等）
 *   - RFIDLib.h：提供 RFID 讀卡模組相關函式（initRFID、checkReadRFIDSuccess、readRFIDUIDString 等）
 *   - clouding.h：提供雲端通訊函式（SendtoClouding 等）
 * 
 * 【錯誤處理機制】
 *   - Wi-Fi 未連線時，會自動嘗試重新連線
 *   - 重新連線成功後繼續傳送資料
 *   - 重新連線失敗則放棄本次傳送，等待下次卡片感應
 *   - 序列監控視窗會輸出詳細的執行狀態，便於除錯
 * 
 * 【使用注意事項】
 *   1. 使用前請確認 TCP.h 中已正確設定 Wi-Fi SSID 與密碼
 *   2. 確認 RFID 模組已正確連接至 I2C 介面
 *   3. 確認雲端伺服器位址與埠號設定正確（clouding.h 中定義）
 *   4. 序列監控視窗的鮑率需設為 9600 bps
 *   5. 本程式使用 invalidrfid.php API，請確認雲端支援此端點
 *   6. 延遲時間可根據實際需求調整（建議 1-3 秒）
 * 
 * =============================================================================
 * 版本紀錄
 * =============================================================================
 * 版本: 1.0
 * 建立日期: 2026-04-05
 * 最後更新: 2026-04-06
 * 作者: 曹永忠
 * =============================================================================
 */

// 門禁裝置讀取卡號傳送雲端失效程式 invalidRFID_inrfidlist_BMduino.ino

// ========================================
// 全域變數定義
// ========================================

/**
 * SSIDData - 儲存所連接的 Wi-Fi AP（無線基地台）的 SSID 名稱
 * 型態：String
 * 用途：記錄目前裝置所連線的無線網路名稱，用於顯示與除錯
 */
String SSIDData;

/**
 * IPData - 儲存開發板取得的 IP 位址字串
 * 型態：String
 * 用途：記錄裝置在區域網路中被分配的 IP 位址，例如 "192.168.1.100"
 */
String IPData;

/**
 * MacData - 儲存開發板的 MAC 位址字串
 * 型態：String
 * 用途：記錄裝置的實體位址，作為設備唯一識別碼，用於雲端 API 呼叫
 * 格式：通常為 "AA:BB:CC:DD:EE:FF" 或 "AABBCCDDEEFF"
 */
String MacData;

// 注意：uidStr（RFID 卡片 UID）已定義於 clouding.h 中，此處不再重複定義

// ========================================
// 外部函式庫引入
// ========================================

/**
 * String.h - Arduino 字串處理函式庫
 * 功能：提供字串的儲存、連接、比較與操作功能
 */
#include <String.h>

/**
 * TCP.h - TCP 通訊函式庫
 * 功能：包含網路連線相關的函式，如 Wi-Fi 初始化、連線狀態檢查、
 *       HTTP 請求等。此檔案需根據所使用的 Wi-Fi 模組進行設定。
 */
#include "TCP.h"

/**
 * RFIDLib.h - RFID 讀卡模組函式庫
 * 功能：提供 BMC11T001 RFID 讀寫模組的通訊控制函式，
 *       包含 I2C 初始化、卡片偵測、UID 讀取等功能。
 */
#include "RFIDLib.h"

/**
 * clouding.h - 雲端通訊函式庫
 * 功能：提供 HTTP GET 方式將資料傳送至雲端伺服器的功能，
 *       包含 SendtoClouding() 函式，負責組合請求、發送資料、
 *       接收回應與解析 JSON。
 */
#include "clouding.h"

// ========================================
// 函式前置宣告
// ========================================

/**
 * initSensor() - 初始化所有感測模組
 * 功能：初始化 RFID 讀卡模組與 Wi-Fi 網路連線
 */
void initSensor();

/**
 * initAll() - 初始化整體系統
 * 功能：初始化序列埠通訊、LED 狀態，並呼叫 initSensor() 初始化感測器
 */
void initAll();

/**
 * GetWiFiInformation() - 取得 WiFi 資訊
 * 功能：取得目前連線的 SSID、IP 位址與 MAC 位址，並儲存至全域變數
 */
void GetWiFiInformation();

/**
 * INITWIFI() - 初始化 Wi-Fi 網路連線
 * 功能：取得 Wi-Fi 資訊、連線至無線網路、顯示連線結果
 */
void INITWIFI();

/**
 * ShowWiFiInformation() - 顯示 Wi-Fi 連線資訊
 * 功能：將 MAC 位址、SSID、IP 位址輸出至序列監控視窗
 */
void ShowWiFiInformation();

// ========================================
// setup() 函式：Arduino 啟動時只執行一次
// ========================================

/**
 * setup() - Arduino 程式啟動點
 * 功能：初始化整體系統，包含序列埠、感測器、Wi-Fi 與 RFID 模組
 * 說明：此函式在開發板通電或重置後只會執行一次
 * 
 * 執行順序：
 *   1. 呼叫 initAll() 初始化整體系統
 *   2. 輸出提示訊息表示系統已準備就緒
 */
void setup() 
{
  // 步驟 1：初始化整體系統
  // 包含序列埠通訊、感測器模組（Wi-Fi、RFID）等初始化工作
  // initAll() 會依序執行：
  //   - Serial.begin(9600) 啟動序列埠
  //   - digitalWrite(LED, LOW) 熄滅內建 LED
  //   - initSensor() 初始化感測器（Wi-Fi 與 RFID）
  initAll();          // 初始化整體系統（序列埠、繼電器、OLED、Wi-Fi、RFID 等模組）
  
  // 步驟 2：輸出開始工作的提示訊息
  // 此訊息表示系統已完成初始化，即將進入主迴圈
  Serial.println("Enter Loop() Area and Start to Work"); // 輸出開始工作的提示訊息
}

// ========================================
// loop() 函式：Arduino 啟動後會重複執行此區塊的程式碼
// ========================================

/**
 * loop() - Arduino 主程式迴圈
 * 功能：持續偵測 RFID 卡片，讀取卡號後傳送至雲端進行失效處理
 * 說明：此函式在 setup() 執行完成後會不斷重複執行
 * 
 * 執行順序：
 *   1. 檢查是否有 RFID 卡片靠近
 *   2. 讀取卡片 UID
 *   3. 檢查 Wi-Fi 連線狀態，必要時重新連線
 *   4. 呼叫 SendtoClouding() 傳送資料至雲端
 *   5. 延遲 2 秒後繼續下一次循環
 */
void loop()
{
  // ========================================================================
  // 步驟 1：檢查是否有 RFID 卡片靠近並成功讀取
  // ========================================================================
  // checkReadRFIDSuccess() 回傳 true 表示偵測到卡片且讀取成功
  // 此函式會自動處理 I2C 通訊與卡片偵測邏輯
  // 若無卡片靠近或讀取失敗，函式會回傳 false，跳過後續處理
  if (checkReadRFIDSuccess())
  {
    // ======================================================================
    // 步驟 2：讀取 RFID 卡片的唯一識別碼（UID）
    // ======================================================================
    // readRFIDUIDString() 會從 RFID 模組讀取卡片 UID 並轉換為字串格式
    // 例如：讀取到的 UID 可能為 "0079262864" 或 "1122334455"
    // uidStr 是定義於 clouding.h 的全域變數，用於儲存卡號
    uidStr = readRFIDUIDString();     // 讀取 RFID 卡片的 UID 並轉換為字串格式

    // ======================================================================
    // 步驟 2.1：將讀取到的卡號輸出至序列監控視窗（除錯用途）
    // ======================================================================
    // 此為除錯用途，可確認 RFID 讀卡模組是否正常運作
    // 輸出格式範例：read RFID Card Number is :(0079262864)
    Serial.print("read RFID Card Number is :(");
    Serial.print(uidStr);
    Serial.print(")\n");

    // ======================================================================
    // 步驟 3：檢查 Wi-Fi 連線狀態
    // ======================================================================
    // Wifi.getStatus() 回傳 true 表示 Wi-Fi 已連線且運作正常
    // 若 Wi-Fi 未連線，則無法將資料傳送至雲端伺服器
    if (Wifi.getStatus())
    {
      // ====================================================================
      // 步驟 3a：Wi-Fi 連線正常
      // ====================================================================
      // 輸出確認訊息至序列監控視窗
      Serial.println("WIFI OK");      // 輸出 Wi-Fi 連線正常訊息至序列監控視窗
      
      // ====================================================================
      // 步驟 4a：呼叫 SendtoClouding() 函式傳送資料至雲端
      // ====================================================================
      // 此函式定義於 clouding.h 中，會執行以下操作：
      //   - 組合 HTTP GET 請求（包含 MAC 位址與 RFID 卡號）
      //   - 將請求傳送至雲端伺服器（invalidrfid.php）
      //   - 接收並解析伺服器回傳的 JSON 資料
      //   - 根據回傳結果判斷卡片失效狀態
      //   - 輸出對應訊息至序列監控視窗
      SendtoClouding();               // 呼叫 SendtoClouding() 函式，將感測資料（卡號）透過 HTTP 傳送至雲端伺服器
    }
    else
    {
      // ====================================================================
      // 步驟 3b：Wi-Fi 未連線，嘗試重新連線
      // ====================================================================
      // INITWIFI() 會執行以下操作：
      //   - 呼叫 GetWiFiInformation() 取得目前 WiFi 資訊
      //   - 呼叫 initWiFi() 連線至預先設定的無線網路
      //   - 呼叫 ShowWiFiInformation() 顯示連線資訊（MAC、SSID、IP）
      Serial.println("WIFI NOT Ready, Reconnecting..."); // 輸出 Wi-Fi 未就緒，正在重新連線的提示
      INITWIFI();          // 初始化 WiFi 網路
      
      // ====================================================================
      // 步驟 3c：重新檢查 Wi-Fi 連線狀態
      // ====================================================================
      if (Wifi.getStatus())
      {
        // 重新連線成功，輸出確認訊息
        Serial.println("WIFI OK");      // 輸出 Wi-Fi 連線正常訊息至序列監控視窗
        
        // ================================================================
        // 步驟 4b：呼叫 SendtoClouding() 函式傳送資料至雲端
        // ================================================================
        SendtoClouding();               // 呼叫 SendtoClouding() 函式，將感測資料（卡號）透過 HTTP 傳送至雲端伺服器
      }
      else
      {
        // 重新連線後仍失敗，輸出錯誤訊息並放棄本次傳送
        // 等待下次卡片感應時再重新嘗試
        Serial.println("WIFI Reconnect Failed, Skip this card"); // 輸出 Wi-Fi 重新連線失敗，跳過本次卡片的提示
      }
    }
  }
  // 若無卡片靠近，則直接跳過上述所有處理，進入延遲階段

  // ========================================================================
  // 步驟 5：延遲 2 秒鐘（2000 毫秒）再進行下一次的讀卡動作
  // ========================================================================
  // 延遲的目的：
  //   1. 避免因程式循環過快導致重複讀取同一張卡片
  //   2. 避免短時間內發送過多 HTTP 請求造成雲端伺服器過度負載
  //   3. 給予使用者足夠的時間移開卡片，防止重複觸發
  // 可根據實際需求調整延遲時間，例如 1000 毫秒（1 秒）或 3000 毫秒（3 秒）
  delay(2000);
}

// ========================================
// initSensor() 函式：初始化所有感測模組
// ========================================

/**
 * initSensor() - 初始化所有感測模組
 * 功能：初始化 Wi-Fi 網路連線與 RFID 讀卡模組
 * 
 * 執行順序：
 *   1. 呼叫 INITWIFI() 初始化 Wi-Fi 網路
 *   2. 呼叫 initRFID() 初始化 RFID 讀卡模組
 * 
 * 注意事項：
 *   - Wi-Fi 初始化失敗會影響雲端通訊功能
 *   - RFID 初始化失敗會導致無法讀取卡片
 */
void initSensor()
{
  // ========================================================================
  // 步驟 1：初始化 Wi-Fi 網路
  // ========================================================================
  // INITWIFI() 會執行以下操作：
  //   - 呼叫 GetWiFiInformation() 取得目前 WiFi 資訊
  //   - 呼叫 initWiFi() 連線至預先設定的無線網路
  //   - 呼叫 ShowWiFiInformation() 顯示連線資訊（MAC、SSID、IP）
  INITWIFI();          // 初始化 WiFi 網路
                       // 此函式應包含 SSID 與密碼的設定，以及連線至無線網路
  
  // ========================================================================
  // 步驟 2：初始化 RFID 讀卡模組
  // ========================================================================
  // initRFID() 會設定 I2C 通訊介面，準備讀取 RFID 卡片 UID
  // 若 RFID 模組初始化失敗，可能需要在序列監控視窗輸出錯誤訊息
  // 此函式定義於 RFIDLib.h 中
  initRFID();          // 初始化 RFID 讀卡模組（BMC11T001）
                       // 設定 I2C 通訊，準備讀取 RFID 卡片 UID
}

// ========================================
// initAll() 函式：初始化整體系統
// ========================================

/**
 * initAll() - 初始化整體系統
 * 功能：啟動序列埠通訊、設定 LED 初始狀態、初始化所有感測器模組
 * 
 * 執行順序：
 *   1. 啟動序列埠通訊（鮑率 9600）
 *   2. 熄滅內建 LED（設定為 LOW 電位）
 *   3. 呼叫 initSensor() 初始化感測器
 * 
 * 注意事項：
 *   - 序列埠鮑率需與 Arduino IDE 序列監控視窗設定的鮑率一致
 *   - 若鮑率不匹配，序列監控視窗將顯示亂碼或無法顯示任何訊息
 */
void initAll()
{
  // ========================================================================
  // 步驟 1：啟動序列埠通訊
  // ========================================================================
  // 設定傳輸速率為 9600 bps，此速率需與 Arduino IDE 序列監控視窗設定的鮑率一致
  // 若鮑率不匹配，序列監控視窗將顯示亂碼或無法顯示任何訊息
  Serial.begin(9600);               // 啟動序列埠通訊，設定傳輸速率為 9600 bps
                                    // 此速率需與 Arduino IDE 序列監控視窗設定的鮑率一致
  
  // ========================================================================
  // 步驟 2：設定內建 LED 狀態
  // ========================================================================
  // 將內建 LED 腳位設定為 LOW 電位（熄滅）
  // 此處可根據需求修改 LED 的初始狀態：
  //   - 可設定為 HIGH 表示開機指示燈亮起
  //   - 可加入閃爍效果表示系統啟動中
  digitalWrite(LED, LOW);           // 將內建 LED 腳位設定為 LOW 電位（熄滅）
                                    // 作為開機狀態指示，可根據實際需求修改為閃爍或其他模式
  
  // ========================================================================
  // 步驟 3：初始化所有感測器模組
  // ========================================================================
  // 包含 Wi-Fi 連線與 RFID 讀卡模組的初始化
  initSensor();                     // 呼叫 initSensor() 函式，初始化所有感測器模組
}

// ========================================
// INITWIFI() 函式：初始化 WiFi 無線網路連線
// ========================================

/**
 * INITWIFI() - 初始化 WiFi 無線網路連線
 * 功能：取得 WiFi 資訊、連線至無線網路、顯示連線結果
 * 
 * 執行順序：
 *   1. 呼叫 GetWiFiInformation() 取得目前 WiFi 資訊
 *   2. 呼叫 initWiFi() 進行 WiFi 連線
 *   3. 呼叫 ShowWiFiInformation() 顯示網路相關資訊
 * 
 * 注意事項：
 *   - 連線資訊（SSID、密碼）應預先設定於 TCP.h 中
 *   - 若連線失敗，initWiFi() 應包含重試機制或錯誤處理
 *   - Wi-Fi 連線成功後方可進行後續的雲端通訊
 */
void INITWIFI()      // 初始化 WiFi 網路
{
  // ========================================================================
  // 步驟 1：取得 WiFi 資訊
  // ========================================================================
  // GetWiFiInformation() 會取得目前連線的 SSID、IP 位址與 MAC 位址
  // 並將這些資訊儲存到全域變數中，同時也輸出到序列埠監控視窗
  GetWiFiInformation();  // 取得 WiFi 資訊（SSID、IP、MAC）
  
  // ========================================================================
  // 步驟 2：連線到預先設定的 WiFi 熱點
  // ========================================================================
  // initWiFi() 會使用 TCP.h 中預先定義的 SSID 與密碼進行連線
  // 連線成功後，裝置會取得一個區域網路的 IP 位址
  initWiFi();             // 連線到預先設定的 WiFi 熱點
                          // 連線資訊（SSID、密碼）應於 TCP.h 中定義
  
  // ========================================================================
  // 步驟 3：顯示 WiFi 連線資訊
  // ========================================================================
  // ShowWiFiInformation() 會將 MAC 位址、SSID、IP 位址輸出至序列監控視窗
  // 便於確認連線狀態與除錯
  ShowWiFiInformation();  // 顯示 MAC / SSID / IP 等連線資訊
}

// ========================================
// GetWiFiInformation() 函式：取得 WiFi 資訊
// ========================================

/**
 * GetWiFiInformation() - 取得目前 WiFi 連線相關資訊
 * 功能：取得 SSID、IP 位址、MAC 位址，並儲存到全域變數與輸出至序列埠
 * 
 * 取得的資訊：
 *   - SSID：目前連線的無線網路名稱
 *   - IP Address：設備在區域網路中被分配的 IP 位址
 *   - MAC Address：設備的實體位址，作為設備唯一識別碼
 * 
 * 輸出格式範例：
 *   ---wifi access point----
 *   MyHomeWiFi
 *   ---Show IP Address----
 *   192.168.1.100
 *   ---MAC Address----
 *   AA:BB:CC:DD:EE:FF
 */
void GetWiFiInformation()  // 取得 WiFi 資訊
{
  // ========================================================================
  // 步驟 1：輸出分隔線與標題
  // ========================================================================
  // 輸出空行與分隔線，便於在序列監控視窗中閱讀
  Serial.println("");                 // 輸出空行，讓序列監控視窗的顯示更美觀
  Serial.println("---wifi access point----"); // 輸出分隔線，標示即將顯示 Wi-Fi 資訊

  // ========================================================================
  // 步驟 2：取得並顯示目前連線的 Wi-Fi AP 名稱（SSID）
  // ========================================================================
  // GetSSID() 函式定義於 TCP.h 中，會從 Wi-Fi 模組讀取目前連線的 SSID
  SSIDData = GetSSID();               // 呼叫 GetSSID() 函式取得目前連線的 AP SSID 字串
  Serial.println(SSIDData);           // 將 SSID 輸出至序列監控視窗，供除錯檢視

  // ========================================================================
  // 步驟 3：取得並顯示開發板的 IP 位址
  // ========================================================================
  // GetIP() 函式定義於 TCP.h 中，會從 Wi-Fi 模組讀取裝置被分配的 IP 位址
  Serial.println("---Show IP Address----"); // 輸出分隔線，標示即將顯示 IP 位址
  IPData = GetIP();                   // 呼叫 GetIP() 函式取得開發板取得的閘道器 IP 位址字串
  Serial.println(IPData);             // 將 IP 位址輸出至序列監控視窗

  // ========================================================================
  // 步驟 4：取得並顯示開發板的 MAC 位址
  // ========================================================================
  // GetMAC() 函式定義於 TCP.h 中，會從 Wi-Fi 模組讀取裝置的實體位址
  Serial.println("---MAC Address----");   // 輸出分隔線，標示即將顯示 MAC 位址
  MacData = GetMAC();                 // 呼叫 GetMAC() 函式取得開發板的 MAC 位址字串
  Serial.println(MacData);            // 將 MAC 位址輸出至序列監控視窗
}

// ========================================
// ShowWiFiInformation() 函式：顯示 WiFi 連線資訊
// ========================================

/**
 * ShowWiFiInformation() - 顯示目前 WiFi 連線相關資訊
 * 功能：取得 MAC 位址、SSID、IP 位址，並輸出至序列埠監控視窗
 * 
 * 輸出的資訊：
 *   - MAC Address：設備的實體位址，作為設備唯一識別碼
 *   - SSID：目前連線的無線網路名稱
 *   - IP Address：設備在區域網路中被分配的 IP 位址
 * 
 * 輸出格式範例：
 *   ---MAC Address----
 *   AA:BB:CC:DD:EE:FF
 *   
 *   ---wifi access point----
 *   MyHomeWiFi
 *   ---Show IP Address----
 *   192.168.1.100
 * 
 * 注意事項：
 *   這些資訊後續也會用於 OLED 螢幕顯示或雲端通訊
 */
void ShowWiFiInformation()  // 顯示 WiFi 資訊
{
  // ========================================================================
  // 步驟 1：取得並儲存 MAC Address
  // ========================================================================
  // GetMAC() 會從 Wi-Fi 模組讀取設備的實體位址
  // MAC 位址格式通常為 "AA:BB:CC:DD:EE:FF" 或 "AABBCCDDEEFF"
  MacData = GetMAC();   // 呼叫自訂函式 GetMAC()，取得目前裝置的 MAC Address
                        // 並將結果存入全域變數 MacData

  Serial.println("---MAC Address----");  // 在序列埠輸出標題文字
  Serial.println(MacData);               // 印出裝置的 MAC Address
  Serial.println("");                    // 空一行，使顯示格式更清楚

  // ========================================================================
  // 步驟 2：取得並儲存 WiFi SSID
  // ========================================================================
  // GetSSID() 會取得目前連線的無線網路名稱（Service Set Identifier）
  Serial.println("---wifi access point----"); // 顯示目前使用的 WiFi AP 資訊標題
  SSIDData = GetSSID(); // 呼叫 GetSSID() 取得目前連線的 WiFi 熱點名稱 (SSID)
                        // 並儲存回全域變數 SSIDData

  Serial.println(SSIDData);  // 印出目前連線的 WiFi 熱點名稱 (SSID)

  // ========================================================================
  // 步驟 3：取得並儲存 IP Address
  // ========================================================================
  // GetIP() 會取得設備在區域網路中被分配的 IP 位址
  // IP 位址格式為 "192.168.x.x" 或 "10.x.x.x" 等
  Serial.println("---Show IP Address----"); // 顯示 IP 位址標題
  IPData = GetIP();     // 呼叫自訂函式 GetIP() 取得目前 WiFi 分配到的 IP 位址
                        // 並儲存回全域變數 IPData

  Serial.println(IPData);  // 在序列埠輸出 IP Address，例如：192.168.1.105
}