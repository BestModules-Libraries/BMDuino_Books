/*
 * 程式名稱：16 鍵矩陣按鍵模組 (BMK52T016) 驅動程式
 * 撰寫語言：Arduino C / C++
 * 對應模組：BMK52T016 I2C 16 鍵矩陣按鍵模組 (BestModules)
 * 
 * ============================================================
 * 程式功能解說：
 * ============================================================
 * 1. 本程式用於驅動 BMK52T016 型號的 16 鍵矩陣按鍵模組，
 *    該模組透過 I2C 通訊介面與 Arduino 開發板連接，
 *    並具備中斷腳位 (INT)，可偵測按鍵事件。
 * 
 * 2. 主要功能：
 *    - 初始化按鍵模組 (init16key)
 *    - 讀取原始按鍵數值 (readkeyvalue)
 *    - 將按鍵數值轉換為對應的字元 (CheckKey)
 * 
 * 3. 按鍵對應表 (KeyPad[])：
 *    索引  0   1   2   3   4   5   6   7   8   9   10  11  12  13  14  15
 *    按鍵 '1','2','3','A','4','5','6','B','7','8','9','C','*','0','#','D'
 * 
 * 4. 運作流程：
 *    (1) 呼叫 init16key() 初始化模組。
 *    (2) 持續呼叫 CheckKey() 或 readkeyvalue() 讀取按鍵狀態。
 *    (3) 當有按鍵被按下時，getINT() 會回傳低電位 (0)，
 *        表示有按鍵事件發生。
 *    (4) readKeyValue() 回傳一個 16 位元的整數 (uint16_t)，
 *        每個位元代表一個按鍵的狀態 (1=按下，0=未按)。
 *    (5) CheckKey() 會掃描這 16 個位元，找出第一個被按下的按鍵，
 *        並回傳對應的字元；若無按鍵則回傳 '~'。
 * 
 * 5. 注意事項：
 *    - 中斷腳位 (INT) 需連接到 Arduino 的數位腳位 (本範例使用腳位 2)
 *    - I2C 介面使用 Wire (A4=SDA, A5=SCL)
 *    - 若同時按下多鍵，CheckKey() 只會回傳掃描到的第一個按鍵
 * ============================================================
 */

//-----------------
//-------- 引入函式庫
#include "BMK52T016.h"  // 引入 BMK52T016 模組所需的專用函式庫

//----------------- 全域變數定義 -----------------
uint16_t readkeypaddata ;  // 儲存讀取到的按鍵矩陣原始資料 (16 位元，每個位元代表一個按鍵)

// 按鍵字元對照表：將矩陣中的每個按鍵位置對應到實際的字元
// 索引 0~15 分別對應模組上的 16 個按鍵
char KeyPad[] = {'1','2','3','A',
                 '4','5','6','B',
                 '7','8','9','C',
                 '*','0','#','D'} ;

//----------------- 模組物件宣告 -----------------
// 宣告一個 BMK52T016 物件，名稱為 BMK52
// 參數說明：
//   第一個參數 (2) ：指定中斷腳位為 Arduino 的數位腳位 2 (連接模組的 INT 腳)
//   第二個參數 (&Wire)：指定使用預設的 I2C 介面 (A4=SDA, A5=SCL)
BMK52T016 BMK52(2, &Wire);

// 若使用 BMduino 開發板上的其他 I2C 介面，可改用以下方式：
// BMK52T016 BMK52(22, &Wire1);  // 使用 Wire1 介面，中斷腳位為 22
// BMK52T016 BMK52(25, &Wire2);  // 使用 Wire2 介面，中斷腳位為 25

//----------------- 函式原型宣告 (Forward Declarations) -----------------
void init16key();      // 初始化 BMK52T016 按鍵模組
int readkeyvalue();    // 讀取按鍵模組的原始數值，無按鍵時回傳 -1
char CheckKey();       // 讀取按鍵值並轉換為對應的字元 (KeyPad 中定義的)

//----------------- 函式實作 -----------------
// 函式名稱：init16key
// 功能：初始化 BMK52T016 16 鍵矩陣按鍵模組
// 參數：無
// 回傳值：無
void init16key()
{
    BMK52.begin();   // 呼叫函式庫的 begin() 方法，初始化模組 (設定 I2C 與中斷模式)
}

// 函式名稱：readkeyvalue
// 功能：讀取按鍵模組的狀態，判斷是否有按鍵被按下
// 參數：無
// 回傳值：
//   - 若無按鍵被按下，回傳 -1
//   - 若有按鍵被按下，回傳 BMK52.readKeyValue() 的結果 (uint16_t 型態，每個位元代表一個按鍵)
int readkeyvalue()
{
    // getINT() 回傳中斷腳位的狀態：
    //   - 回傳 0：表示有按鍵事件 (中斷腳位為低電位)
    //   - 回傳 1：表示無按鍵事件 (中斷腳位為高電位)
    if (BMK52.getINT() == 0)   // 檢查是否有人按下按鍵
    {
        return BMK52.readKeyValue();   // 有人按鍵，回傳按鍵矩陣數值
    }
    else
    {
        return (-1);   // 沒有人按鍵，回傳 -1 表示無按鍵
    }
}

// 函式名稱：CheckKey
// 功能：讀取按鍵模組的數值，並轉換為 KeyPad 陣列中定義的對應字元
// 參數：無
// 回傳值：
//   - 若有按鍵被按下，回傳該按鍵對應的字元 (如 '1', 'A', '#' 等)
//   - 若無按鍵或發生錯誤，回傳 '~' (波浪號，代表無效按鍵)
char CheckKey()
{
    int readk ;           // 暫存讀取到的位元值 (0 或 1)
    int keyend = 15 ;     // 按鍵陣列的最大索引值 (共 16 鍵，索引 0~15)
    int keycount = 0 ;    // 迴圈計數器，用來掃描 16 個按鍵位置
    
    // 先呼叫 readkeyvalue() 檢查是否有按鍵被按下
    // 若回傳 -1，表示沒有任何按鍵被按下，直接回傳 '~'
    if (readkeyvalue() == -1)
        return '~' ;
    
    // 若有按鍵被按下，則讀取完整的按鍵矩陣資料 (16 位元)
    readkeypaddata = BMK52.readKeyValue();
    
    // 逐位元掃描 (從 bit0 到 bit15)
    while (keycount <= keyend)
    {
        // 使用 bitRead() 函式讀取 readkeypaddata 的第 keycount 個位元
        // bitRead(數值, 位元位置) 會回傳 0 或 1
        readk = bitRead(readkeypaddata, keycount);
        
        // 若該位元為 1，表示對應位置的按鍵被按下
        if (readk == 1)
        {
            // 根據索引值回傳 KeyPad 陣列中定義的字元
            return KeyPad[keycount];
        }
        keycount++;   // 繼續檢查下一個位元
    }
    
    // 理論上不應該執行到這裡 (因為前面已確認有按鍵，但掃描卻沒找到)
    // 若發生則回傳 '~' 代表錯誤或無效按鍵
    return '~' ;
}